## conf/layer.conf
```bitbake
# We have a conf and classes directory, add to BBPATH
BBPATH =. "${LAYERDIR}:"

# We have recipes-* directories, add to BBFILES
BBFILES += "${LAYERDIR}/recipes-*/*/*.bb \
            ${LAYERDIR}/recipes-*/*/*.bbappend"

BBFILE_COLLECTIONS += "course"
BBFILE_PATTERN_course = "^${LAYERDIR}/"
BBFILE_PRIORITY_course = "10"

LAYERSERIES_COMPAT_yocto = "dunfell"
LAYERDEPENDS_course = "core yocto"
```
